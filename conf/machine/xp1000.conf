## conf/machine/xp1000.conf
```bitbake
#@TYPE: Machine
#@NAME: xp1000
#@DESCRIPTION: Machine configuration for the xp1000

MKUBIFS_ARGS = "-m 2048 -e 126976 -c 4096"
UBINIZE_ARGS = "-m 2048 -p 128KiB"

DEFAULTTUNE = "mips32el-nf"

MACHINE_FEATURES += " textlcd 7segment ci nofhdskin HDMI SCART"
DISTRO_FEATURES_remove = "x11 wayland directfb"

CHIPSET = "bcm7358"
RCTYPE = "14"

require conf/machine/include/xp.inc

RCNAME = "xp1000"

MTD_KERNEL = "mtd1"
MTD_ROOTFS = "mtd2"
KERNEL_FILE = "kernel.bin"
ROOTFS_FILE = "rootfs.bin"

SOC_FAMILY = "bcm7358"

BOX_BRAND = "xp"
```
